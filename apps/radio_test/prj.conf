## CMakeLists.txt
```
cmake_minimum_required(VERSION 3.20.0)
find_package(Zephyr REQUIRED HINTS $ENV{ZEPHYR_BASE})
project(radio_test)
target_sources(app PRIVATE src/main.c)
```

## prj.conf
```kconfig
# Radio bring-up test for LPSTK-CC1352R.
#
# NOTE: not using CONFIG_IEEE802154_RAW_MODE -- the cc13xx driver calls
# net_recv_data() and ieee802154_handle_ack() unconditionally, so it does not
# link without the net core and the 802.15.4 L2. We enable the real L2 and
# simply drive the radio API directly from main().
CONFIG_NETWORKING=y
CONFIG_IEEE802154=y
CONFIG_NET_L2_IEEE802154=y

# 2.4 GHz only; the sub-GHz driver is a separate device we do not need.
CONFIG_IEEE802154_CC13XX_CC26XX_SUB_GHZ=n

CONFIG_NET_IPV6=n
CONFIG_NET_IPV4=n
CONFIG_NET_UDP=n
CONFIG_NET_TCP=n
CONFIG_NET_CONFIG_AUTO_INIT=n

CONFIG_NET_PKT_RX_COUNT=6
CONFIG_NET_PKT_TX_COUNT=6
CONFIG_NET_BUF_DATA_SIZE=128

CONFIG_CONSOLE=y
CONFIG_UART_CONSOLE=y
CONFIG_SERIAL=y
CONFIG_PRINTK=y

CONFIG_LOG=y
CONFIG_LOG_MODE_IMMEDIATE=y
CONFIG_IEEE802154_DRIVER_LOG_LEVEL_DBG=y

CONFIG_TEST_RANDOM_GENERATOR=y
CONFIG_MAIN_STACK_SIZE=2048

# The cc13xx TRNG driver interrupt-storms on this board: its ISR only ACKs
# TRNG_NUMBER_READY and TRNG_FRO_SHUTDOWN, so any other status bit re-fires
# forever and starves every thread (main never runs). Not needed here.
CONFIG_ENTROPY_CC13XX_CC26XX_RNG=n

# The board defconfig enables the ROM bootloader backdoor on DIO15 (active low).
# If DIO15 sits low at reset the ROM traps into the serial bootloader and the
# application never runs -- observed here as PC parked at a fixed early-ROM
# address with no console output. We don't need the backdoor.
CONFIG_CC13X2_CC26X2_BOOTLOADER_BACKDOOR_ENABLE=n
CONFIG_CC13X2_CC26X2_BOOTLOADER_ENABLE=n
```

## src/main.c
```c
/*
 * Radio bring-up test for LPSTK-CC1352R.
 *
 * Purpose: determine whether the CC1352R radio can be started at all on this
 * board. TI's LaunchPad sniffer firmware blocked forever inside CMD_FS waiting
 * for the synthesiser to lock, with no fault and no interrupt. If Zephyr's
 * driver starts the radio here, the silicon is fine and TI's firmware was
 * simply built for the wrong board. If this stalls in the same place, the
 * fault is in hardware.
 *
 * Each step prints BEFORE it runs, so a stall is visible by what is missing.
 */
#include <zephyr/kernel.h>
#include <zephyr/device.h>
#include <zephyr/net/ieee802154_radio.h>
#include <zephyr/sys/printk.h>

static const struct device *const radio_dev =
	DEVICE_DT_GET(DT_CHOSEN(zephyr_ieee802154));

static void print_caps(enum ieee802154_hw_caps caps)
{
	printk("capabilities = 0x%08x\n", (unsigned int)caps);
	printk("  ENERGY_SCAN     %c\n", (caps & IEEE802154_HW_ENERGY_SCAN)    ? 'y' : 'n');
	printk("  FCS             %c\n", (caps & IEEE802154_HW_FCS)            ? 'y' : 'n');
	printk("  FILTER          %c\n", (caps & IEEE802154_HW_FILTER)         ? 'y' : 'n');
	printk("  PROMISC         %c  <- needed for sniffing\n",
	                                 (caps & IEEE802154_HW_PROMISC)        ? 'y' : 'n');
	printk("  CSMA            %c\n", (caps & IEEE802154_HW_CSMA)           ? 'y' : 'n');
	printk("  TX_RX_ACK       %c\n", (caps & IEEE802154_HW_TX_RX_ACK)      ? 'y' : 'n');
}

int main(void)
{
	struct ieee802154_radio_api *api;
	int ret;

	printk("\n\n=== LPSTK-CC1352R radio bring-up test ===\n");
	printk("board: %s\n", CONFIG_BOARD);

	printk("[1] checking device readiness...\n");
	if (!device_is_ready(radio_dev)) {
		printk("    FAIL: radio device not ready\n");
		return 0;
	}
	printk("    OK: %s\n", radio_dev->name);

	api = (struct ieee802154_radio_api *)radio_dev->api;

	printk("[2] reading capabilities...\n");
	print_caps(api->get_capabilities(radio_dev));

	printk("[3] set_channel(11)... (2405 MHz)\n");
	ret = api->set_channel(radio_dev, 11);
	printk("    -> %d %s\n", ret, ret == 0 ? "OK" : "FAILED");

	/* This is the step that hung under TI's firmware. If the next line
	 * never appears, the synthesiser failed to lock again. */
	printk("[4] start() -- THIS is where TI's firmware hung...\n");
	ret = api->start(radio_dev);
	printk("    -> %d %s\n", ret, ret == 0 ? "OK -- RADIO IS RUNNING" : "FAILED");

	if (ret == 0) {
		printk("\n*** RADIO STARTED. Hardware is good. ***\n");
	}

	for (int i = 0;; i++) {
		k_sleep(K_SECONDS(5));
		printk("alive %d (radio %s)\n", i, ret == 0 ? "running" : "stopped");
	}
	return 0;
}
```
